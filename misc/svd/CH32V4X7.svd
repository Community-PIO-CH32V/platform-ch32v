# CH32V407 register map
Vendor: WCH Ltd.; File version: 1.0
CH32V407 View File
Registers are 32-bit, read-write, reset 0x0 unless marked. A register's access mark holds for its fields unless they carry their own. Offsets are from the block's base; lines under a group give offsets from that group; [hi:lo] are bit positions; {n}, {i} and the like mark numbered series; 'fields as' and 'values as' point back to an identical list; <NAME> marks a mode.

## Memory map
0x1FFFF7E0 ESIG size 0x200 — ESIG configuration
0x40000000 TIM2 size 0x400 — General purpose timer
0x40000400 TIM3 size 0x400
0x40000800 TIM4 size 0x400
0x40000C00 TIM5 size 0x400
0x40001000 TIM6 size 0x400 — Basic timer
0x40001400 TIM7 size 0x400
0x40001800 USART6 size 0x400
0x40001C00 USART7 size 0x400
0x40002000 USART8 size 0x400
0x40002800 RTC size 0x400 — Real time clock
0x40002C00 WWDG size 0x400 — Window watchdog
0x40003000 IWDG size 0x400 — Independent watchdog
0x40003800 SPI2 size 0x400 — Serial peripheral interface
0x40003C00 SPI3 size 0x400
0x40004400 USART2 size 0x400
0x40004800 USART3 size 0x400
0x40004C00 USART4 size 0x400
0x40005000 USART5 size 0x400
0x40005400 I2C size 0x400 — Inter integrated circuit
0x40006400 CAN size 0x400 — Controller area network
0x40006C00 BKP size 0x400 — Backup registers
0x40007000 PWR size 0x400 — Power control
0x40007400 DAC size 0x400 — Digital to analog converter
0x40007800 USART9 size 0x400
0x40007C00 USART10 size 0x400
0x40010000 AFIO size 0x400 — Alternate function I/O
0x40010400 EXTI size 0x400
0x40010800 GPIOA size 0x400 — General purpose I/O
0x40010C00 GPIOB size 0x400
0x40011000 GPIOC size 0x400
0x40011400 GPIOD size 0x400
0x40011800 GPIOE size 0x400
0x40012400 ADC1 size 0x400 — Analog to digital converter
0x40012800 ADC2 size 0x400
0x40012C00 TIM1 size 0x400 — Advanced timer
0x40013000 SPI1 size 0x400 — Serial peripheral interface
0x40013400 TIM8 size 0x400
0x40013800 USART1 size 0x400 — Universal synchronous asynchronous receiver transmitter
0x40018000 SDIO size 0x400 — Secure digital input/output interface
0x40020000 DMA1 size 0x400 — DMA1 controller
0x40020400 DMA2 size 0x400 — DMA2 controller
0x40021000 RCC size 0x400 — Reset and clock control
0x40022000 FLASH size 0x400
0x40023000 CRC size 0x400 — CRC calculation unit
0x40023400 USBHS2 size 0x400
0x40023800 EXTEND size 0x400 — Extend configuration
0x40023C00 RNG size 0x400 — Random number generator
0x40024000 USBHS1 size 0x400 — USB register
0x40024400 PSRAM size 0x400
0x40024800 LTDC size 0x400 — LCD-TFT Controller
0x40024C00 I3C size 0x400 — Improved inter-integrated circuit
0x40025000 ARGB size 0x400
0x40406000 ETHERNET_MAC size 0x100 — Ethernet: media access control
0x40406100 ETHERNET_MMC size 0x400 — Ethernet: MAC management counters
0x40406700 ETHERNET_PTP size 0x400 — Ethernet: Precision time protocol
0x40407000 ETHERNET_DMA size 0x400 — Ethernet: DMA controller operation
0x50050000 DVP size 0x400 — Digital Video Port
0xA0000000 FSMC size 0x1000 — Flexible static memory controller
0xE000E000 PFIC size 0x1000 — Programmable Fast Interrupt Controller
0xE000F000 STK size 0xFFF — SysTick

## Interrupts
16 WWDG — Window Watchdog interrupt
17 PVD (PWR) — PVD through EXTI line detection interrupt
18 TAMPER (EXTI) — Tamper interrupt
19 RTC — RTC global interrupt
20 FLASH — Flash global interrupt
21 RCC — RCC global interrupt
22 EXTI0 (EXTI) — EXTI Line0 interrupt
23 EXTI1 (EXTI) — EXTI Line1 interrupt
24 EXTI2 (EXTI) — EXTI Line2 interrupt
25 EXTI3 (EXTI) — EXTI Line3 interrupt
26 EXTI4 (EXTI) — EXTI Line4 interrupt
27 DMA1_CH1 (DMA1) — DMA1 Channel1 global interrupt
28 DMA1_CH2 (DMA1) — DMA1 Channel2 global interrupt
29 DMA1_CH3 (DMA1) — DMA1 Channel3 global interrupt
30 DMA1_CH4 (DMA1) — DMA1 Channel4 global interrupt
31 DMA1_CH5 (DMA1) — DMA1 Channel5 global interrupt
32 DMA1_CH6 (DMA1) — DMA1 Channel6 global interrupt
33 DMA1_CH7 (DMA1) — DMA1 Channel7 global interrupt
34 ADC1_2 (ADC1) — ADC1_2 global interrupt
35 CAN1_TX (CAN) — CAN1 TX interrupt
36 CAN1_RX0 (CAN) — CAN1 RX0 interrupt
37 CAN1_RX1 (CAN) — CAN1 RX1 interrupt
38 CAN1_SCE (CAN) — CAN1 SCE interrupt
39 EXTI9_5 (EXTI) — EXTI Line[9:5] interrupts
40 TIM1_BRK (TIM1) — TIM1 Break interrupt
41 TIM1_UP (TIM1) — TIM1 Update interrupt
42 TIM1_TRG_COM (TIM1) — TIM1 Trigger and Commutation interrupts
43 TIM1_CC (TIM1) — TIM1 Capture Compare interrupt
44 TIM2 — TIM2 global interrupt
45 TIM3 — TIM3 global interrupt
46 TIM4 — TIM4 global interrupt
47 I2C_EV (I2C) — I2C event interrupt
48 I2C_ER (I2C) — I2C error interrupt
49 I3C_EV (I3C) — I3C event interrupt
50 I3C_ER (I3C) — I3C error interrupt
51 SPI1 — SPI1 global interrupt
52 SPI2 — SPI2 global interrupt
53 USART1 — USART1 global interrupt
54 USART2 — USART2 global interrupt
55 USART3 — USART3 global interrupt
56 EXTI15_10 (EXTI) — EXTI Line[15:10] interrupts
57 RTCAlarm (RTC) — RTC Alarms through EXTI line interrupt
58 USBHS1WakeUP (USBHS1) — USBHS1 Wakeup interrupt
59 TIM8_BRK (TIM8) — TIM8 Break interrupt
60 TIM8_UP (TIM8) — TIM8 Update interrupt
61 TIM8_TRG_COM (TIM8) — TIM8 Trigger and Commutation interrupts
62 TIM8_CC (TIM8) — TIM8 Capture Compare interrupt
63 RNG — RNG interrupt
65 SDIO — SDIO global interrupt
66 TIM5 — TIM5 global interrupt
67 SPI3 — SPI3 global interrupt
68 USART4 — USART2 global interrupt
69 USART5 — USART5 global interrupt
70 TIM6 — TIM6 Basic interrupt
71 TIM7 — TIM7 Basic interrupt
72 DMA2_CH1 (DMA2) — DMA2 Channel1 global interrupt
73 DMA2_CH2 (DMA2) — DMA2 Channel2 global interrupt
74 DMA2_CH3 (DMA2) — DMA2 Channel3 global interrupt
75 DMA2_CH4 (DMA2) — DMA2 Channel4 global interrupt
76 DMA2_CH5 (DMA2) — DMA2 Channel5 global interrupt
77 ETH (ETHERNET_MAC) — Ethernet global interrupt
78 ETH_WKUP (ETHERNET_MAC) — Ethernet Wakeup through EXTI line interrupt
79 LTDC — LCD-TFT global interrupt
80 PSRAM — PSRAM global interrupt
81 USART9 — USART9 global interrupt
82 USART10 — USART10 global interrupt
83 USBHS1 — USBHS1 global interrupt
84 USBHS2 — USBHS2 global interrupt
85 USBHS2WakeUP (USBHS2) — USBHS2 Wakeup interrupt
86 DVP — DVP global Interrupt interrupt
87 USART6 — USART6 global interrupt
88 USART7 — USART7 global interrupt
89 USART8 — USART8 global interrupt
90 DMA1_CH8 (DMA1) — DMA1 Channel8 global interrupt
91 DMA1_CH9 (DMA1) — DMA1 Channel9 global interrupt
92 DMA1_CH10 (DMA1) — DMA1 Channel10 global interrupt
93 DMA1_CH11 (DMA1) — DMA1 Channel11 global interrupt
94 DMA1_CH12 (DMA1) — DMA1 Channel12 global interrupt
95 DMA1_CH13 (DMA1) — DMA1 Channel13 global interrupt
96 I3CWakeUP (I3C) — I3C wakeup interrupt
97 ARGB — ARGB global interrupts
98 DMA2_CH6 (DMA2) — DMA2 Channel6 global interrupt
99 DMA2_CH7 (DMA2) — DMA2 Channel7 global interrupt
100 DMA2_CH8 (DMA2) — DMA2 Channel8 global interrupt
101 DMA2_CH9 (DMA2) — DMA2 Channel9 global interrupt
102 DMA2_CH10 (DMA2) — DMA2 Channel10 global interrupt
103 DMA2_CH11 (DMA2) — DMA2 Channel11 global interrupt
